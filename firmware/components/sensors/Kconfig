## firmware/components/sensors/Kconfig
```kconfig
menu "SAgrIoT sensors"

    config SAGRIOT_I2C_SDA_GPIO
        int "SHT31 SDA pin"
        default 8

    config SAGRIOT_I2C_SCL_GPIO
        int "SHT31 SCL pin"
        default 9

    config SAGRIOT_RS485_TX_GPIO
        int "RS485 module DI (ESP TX) pin"
        default 17

    config SAGRIOT_RS485_RX_GPIO
        int "RS485 module RO (ESP RX) pin"
        default 18

    config SAGRIOT_RS485_DE_GPIO
        int "RS485 module DE+RE pin (-1: auto-direction module)"
        default -1
        range -1 48

    config SAGRIOT_PROBE_BAUD
        int "Probe baud rate"
        default 9600

    config SAGRIOT_PROBE_SLAVE_ID
        int "Probe Modbus address"
        default 1
        range 1 247

    config SAGRIOT_PROBE_PWR_GPIO
        int "Probe power MOSFET gate pin (-1: probe always on)"
        default -1
        range -1 48

    config SAGRIOT_PROBE_PWR_ACTIVE_LOW
        bool "Probe power is on when the pin is low (P-MOSFET, high side)"
        default y

    config SAGRIOT_PROBE_WARMUP_MS
        int "Probe warm-up after power on (ms)"
        default 1000
        range 0 10000
        help
            Time from switching the probe on to the first Modbus request.
            Check the probe's datasheet; too short gives timeouts or
            wrong first values.

endmenu
```

## firmware/main/Kconfig.projbuild
```kconfig
menu "SAgrIoT node"

    config SAGRIOT_WIFI_SSID
        string "Wi-Fi SSID (2.4 GHz)"
        default "my-wifi"

    config SAGRIOT_WIFI_PASSWORD
        string "Wi-Fi password"
        default ""

    config SAGRIOT_WIFI_EAP_IDENTITY
        string "WPA2-Enterprise identity (empty: WPA2-Personal)"
        default ""
        help
            For a campus network that asks for a user name, e.g.
            name@school.edu. The password above is used with it.

    config SAGRIOT_MQTT_URI
        string "MQTT broker URI"
        default "mqtt://192.168.1.10:1883"
        help
            The gateway's broker. During development: the Mac's IP on the
            same network (ipconfig getifaddr en0).

    config SAGRIOT_NODE_ID
        string "Node id (used in the topics)"
        default "node01"


    config SAGRIOT_PERIOD_MS
        int "Cycle period (ms)"
        default 2000
        range 200 3600000
        help
            A real node uses 300000 (5 min). Replay tests use a short
            period so hours of data go through in minutes.

    choice SAGRIOT_SOURCE
        prompt "Where samples come from"
        default SAGRIOT_SOURCE_REPLAY

        config SAGRIOT_SOURCE_REPLAY
            bool "Recorded log (components/replay)"

        config SAGRIOT_SOURCE_SENSORS
            bool "Sensors (SHT31 + RS485 probe, components/sensors)"
    endchoice

    config SAGRIOT_TINYML
        bool "Also run Derya's model (components/tinyml)"
        default y
        help
            Sends a second decision message with "model":"tinyml" every
            cycle, from the same 24 h buffer. 31.5 KB of flash, about
            0.75 ms per cycle on the ESP32-S3 (experiments/tinyml_bench).

    config SAGRIOT_DEEP_SLEEP
        bool "Deep sleep between cycles"
        default n
        help
            One cycle per wake: read, decide, send, wait for the broker's
            acknowledgement, then deep sleep for the rest of the period.
            The 24 h buffer and seq stay in RTC memory. Needs a period
            well above the Wi-Fi + MQTT connect time (use 300000).
            Off: the node stays awake and loops (replay tests).

    config SAGRIOT_CONNECT_TIMEOUT_MS
        int "Deep sleep: give up on Wi-Fi + MQTT after (ms)"
        default 15000
        range 1000 120000
        depends on SAGRIOT_DEEP_SLEEP
        help
            If the gateway cannot be reached in this time, the cycle is
            counted as lost and the node sleeps anyway (saves battery).

endmenu
```
